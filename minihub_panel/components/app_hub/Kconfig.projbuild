## minihub_panel/components/app_hub/Kconfig.projbuild
```kconfig
menu "MiniHub panel"

config MINIHUB_PANEL_HUB_USERNAME
    string "MiniHub username"
    default "admin"

config MINIHUB_PANEL_HUB_PASSWORD
    string "MiniHub password"
    default ""

config MINIHUB_PANEL_API_TOKEN
    string "MiniHub bearer token"
    default ""
    help
        Unused when the panel talks to the on-device Host with login auth off.

endmenu
```

## tof_instruments/sdkconfig.defaults
```kconfig
CONFIG_IDF_TARGET="esp32s31"
CONFIG_IDF_EXPERIMENTAL_FEATURES=y
CONFIG_COMPILER_OPTIMIZATION_PERF=y

CONFIG_ESPTOOLPY_FLASHMODE_QIO=y
CONFIG_ESPTOOLPY_FLASHSIZE_16MB=y
CONFIG_PARTITION_TABLE_CUSTOM=y
CONFIG_PARTITION_TABLE_CUSTOM_FILENAME="partitions.csv"
CONFIG_ESP_COREDUMP_ENABLE_TO_FLASH=y
CONFIG_APP_RETRIEVE_LEN_ELF_SHA=64
CONFIG_BOOTLOADER_APP_ROLLBACK_ENABLE=y
CONFIG_FACTORY_RECOVERY_BOOT_GPIO=7
CONFIG_FACTORY_RECOVERY_BOOT_DEBOUNCE_MS=50

CONFIG_ESP_CONSOLE_UART_DEFAULT=y
# CONFIG_ESP_CONSOLE_USB_SERIAL_JTAG is not set
CONFIG_ESP_CONSOLE_SECONDARY_NONE=y
CONFIG_ESP_IRIS_TRANSPORT_USB=y
CONFIG_ESP_IRIS_TRANSPORT_TCP=y
CONFIG_ESP_IRIS_NVS_PARTITION_NAME="sysmeta"
CONFIG_ESP_IRIS_TRANSPORT_CLAIM_TIMEOUT_MS=2000
CONFIG_ESP_IRIS_TCP_PORT=19772
CONFIG_ESP_IRIS_TCP_PAIRING=y
CONFIG_ESP_IRIS_TASK_STACK_SIZE=3328
CONFIG_ESP_IRIS_LOG_RING_BYTES=4096
CONFIG_ESP_IRIS_LOG_RING_STORAGE_INTERNAL=y
CONFIG_TINYUSB_CDC_COUNT=2
CONFIG_TINYUSB_CDC_RX_BUFSIZE=8192
CONFIG_TINYUSB_CDC_TX_BUFSIZE=8192
CONFIG_TINYUSB_CDC_EP_BUFSIZE=8192

CONFIG_BSP_CO5300_ENABLE_TE=y
CONFIG_BSP_MOTOR_ENABLE_PWM=y
CONFIG_LV_CONF_SKIP=y
CONFIG_LV_COLOR_DEPTH_16=y
CONFIG_LV_OS_FREERTOS=y
CONFIG_LV_USE_CLIB_MALLOC=y
CONFIG_LV_USE_CLIB_STRING=y
CONFIG_LV_USE_CLIB_SPRINTF=y
CONFIG_LV_ASSERT_HANDLER_INCLUDE="assert.h"

CONFIG_SPIRAM=y
CONFIG_SPIRAM_SPEED_250M=y
CONFIG_SPIRAM_XIP_FROM_PSRAM=y
CONFIG_SPIRAM_MEMTEST=n

CONFIG_ESP_MAIN_TASK_STACK_SIZE=20480
CONFIG_ESP_TASK_WDT_INIT=n

# Cap moving UI at 40 Hz so render work does not backlog behind panel flushes.
CONFIG_ESP_GSP_RENDER_TASK_PRIORITY=6
CONFIG_ESP_GSP_ACTIVE_TICK_MS=25

CONFIG_APP_PROJECT_VER_FROM_CONFIG=y
CONFIG_APP_PROJECT_VER="0.1.0"
```
